## boards/shields/dm_5x6/Kconfig.defconfig
```kconfig
if SHIELD_DM_5X6_LEFT

config ZMK_KEYBOARD_NAME
    default "dm-5x6"

config ZMK_SPLIT_ROLE_CENTRAL
    default y

endif # SHIELD_DM_5X6_LEFT

if SHIELD_DM_5X6_LEFT || SHIELD_DM_5X6_RIGHT

config ZMK_SPLIT
    default y

endif # SHIELD_DM_5X6_LEFT || SHIELD_DM_5X6_RIGHT
```

## boards/shields/dm_5x6/Kconfig.shield
```kconfig
config SHIELD_DM_5X6_LEFT
    def_bool $(shields_list_contains,dm_5x6_left)

config SHIELD_DM_5X6_RIGHT
    def_bool $(shields_list_contains,dm_5x6_right)
```
